## config/west.yml
```yaml
manifest:
  defaults:
    remote: upstream
    revision: main

  remotes:
    - name: upstream
      url-base: https://github.com/zmkfirmware
    - name: urob
      url-base: https://github.com/urob

  projects:
    - name: zmk-helpers
      path: modules/helpers
    - name: zmk-auto-layer
      path: modules/auto-layer
    - name: zmk-tri-state
      path: modules/tri-state
    - name: zmk-leader-key
      path: modules/leader-key

    # ZMK with Zephyr namespaced under /zmk. This requires that ZMK imports
    # Zephyr with a path other than `zephyr` (as in `going-modular`).
    - name: zmk
      path: .
      import:
        file: app/west.yml
        path-prefix: zmk

  self:
    path: config
```
